## build/Kconfig/arch/Kconfig
```kconfig
# Load Zephyr Arch Kconfig descriptions.
osource "/home/gustavo1/zephyrproject/zephyr/arch/rx/Kconfig"
osource "/home/gustavo1/zephyrproject/zephyr/arch/x86/Kconfig"
osource "/home/gustavo1/zephyrproject/zephyr/arch/xtensa/Kconfig"
osource "/home/gustavo1/zephyrproject/zephyr/arch/sparc/Kconfig"
osource "/home/gustavo1/zephyrproject/zephyr/arch/riscv/Kconfig"
osource "/home/gustavo1/zephyrproject/zephyr/arch/posix/Kconfig"
osource "/home/gustavo1/zephyrproject/zephyr/arch/mips/Kconfig"
osource "/home/gustavo1/zephyrproject/zephyr/arch/arm64/Kconfig"
osource "/home/gustavo1/zephyrproject/zephyr/arch/arm/Kconfig"
osource "/home/gustavo1/zephyrproject/zephyr/arch/arc/Kconfig"
```

## build/Kconfig/boards/Kconfig
```kconfig
# Load Zephyr board Kconfig descriptions.
osource "/home/gustavo1/zephyrproject/zephyr/boards/espressif/esp32_devkitc/Kconfig"
```

## build/Kconfig/boards/Kconfig.defconfig.tmp
```kconfig
# Load Zephyr board defconfig descriptions.
osource "/home/gustavo1/zephyrproject/zephyr/boards/espressif/esp32_devkitc/Kconfig.defconfig"
```

## build/Kconfig/boards/Kconfig.esp32_devkitc.tmp
```kconfig
# Load board Kconfig descriptions.
osource "/home/gustavo1/zephyrproject/zephyr/boards/espressif/esp32_devkitc/Kconfig.esp32_devkitc"
```
